## conf/machine/apf6dev-dual.conf
```bitbake
#@TYPE: Machine
#@NAME: Armadeus APF6 Dev. board with SOM based on i.MX6 Dual
#@SOC: i.MX6D
#@DESCRIPTION: Machine configuration for Armadeus APF6 (dual) boards

include conf/machine/include/imx-base.inc
include conf/machine/include/tune-cortexa9.inc
include apf6dev.inc

SOC_FAMILY = "mx6:mx6q:apf6:apf6q"
UBOOT_MACHINE = "apf6_config"
KERNEL_DEVICETREE = "imx6q-apf6dev.dtb"
```

## conf/machine/apf6dev-quad.conf
```bitbake
#@TYPE: Machine
#@NAME: Armadeus APF6 Dev. board with SOM based on i.MX6 Quad
#@SOC: i.MX6Q
#@DESCRIPTION: Machine configuration for Armadeus APF6 (quad) boards

include conf/machine/include/imx-base.inc
include conf/machine/include/tune-cortexa9.inc
include apf6dev.inc

SOC_FAMILY = "mx6:mx6q:apf6:apf6q"
UBOOT_MACHINE = "apf6_config"
KERNEL_DEVICETREE = "imx6q-apf6dev.dtb"
```

## conf/machine/apf6dev-solo.conf
```bitbake
#@TYPE: Machine
#@NAME: Armadeus APF6 Dev. board with SOM based on i.MX6 Solo
#@SOC: i.MX6S
#@DESCRIPTION: Machine configuration for Armadeus APF6 (solo) boards

include conf/machine/include/imx-base.inc
include conf/machine/include/tune-cortexa9.inc
include apf6dev.inc

SOC_FAMILY = "mx6:mx6dl:apf6:apf6dl"
UBOOT_MACHINE = "apf6_config"
KERNEL_DEVICETREE = "imx6dl-apf6dev.dtb"
```

## conf/machine/apf6dev.inc
```bitbake
# Armadeus APF6 common variables
# Supported platform : APF6 (Solo - Dual - Quad)
PREFERRED_PROVIDER_virtual/kernel ?= "linux-apf6"
PREFERRED_VERSION_linux-wandboard ?= "3.10.53"
PREFERRED_PROVIDER_u-boot ?= "u-boot-apf6"

SERIAL_CONSOLE = "115200 ttymxc3"

MACHINE_FEATURES += "wifi pci touchscreen"

KERNEL_IMAGETYPE = "zImage"
```
